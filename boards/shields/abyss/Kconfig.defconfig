## boards/shields/abyss/Kconfig.defconfig
```kconfig
if SHIELD_ABYSS_LEFT

config ZMK_KEYBOARD_NAME
	default "abyss"

config ZMK_SPLIT_ROLE_CENTRAL
	default y

config ZMK_SPLIT_BLE_CENTRAL_PERIPHERALS
  default 1

config BT_MAX_CONN
  default 6

config BT_MAX_PAIRED
  default 6

endif

if SHIELD_ABYSS_LEFT || SHIELD_ABYSS_RIGHT

config ZMK_SPLIT
	default y

endif
```

## config/boards/shields/abyss/Kconfig.defconfig
```kconfig
if SHIELD_ABYSS_LEFT

config ZMK_KEYBOARD_NAME
	default "abyss"

config ZMK_SPLIT_ROLE_CENTRAL
	default y

endif

if SHIELD_ABYSS_LEFT || SHIELD_ABYSS_RIGHT

config ZMK_SPLIT
	default y

endif
```

## config/boards/shields/abyss/Kconfig.shield
```kconfig
config SHIELD_ABYSS_LEFT
	def_bool $(shields_list_contains,abyss_left)

config SHIELD_ABYSS_RIGHT
	def_bool $(shields_list_contains,abyss_right)
```

## config/west.yml
```yaml
manifest:
  defaults:
    revision: v0.3
  remotes:
    - name: zmkfirmware
      url-base: https://github.com/zmkfirmware
    # - name: snoyer
    #   url-base: https://github.com/snoyer
  projects:
    - name: zmk
      remote: zmkfirmware
      import: app/west.yml
    # - name:  zmk-behavior-capslock
    #   remote: snoyer
    #   revision: main
  self:
    path: config
```
